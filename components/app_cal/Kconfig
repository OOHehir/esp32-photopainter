## components/app_cal/Kconfig
```kconfig
menu "app_cal -- calendars"

config APP_CAL_SEED
    string "Calendars to configure on first boot"
    default ""
    help
        Whitespace-separated `name,color,url` entries, for example
        `Family,blue,https://calendar.google.com/calendar/ical/.../basic.ics`.
        Colors: blue, red, green, yellow, black. Read only while NVS holds no calendar
        list; the web page edits the list after that. The URL is a credential: set this
        in sdkconfig.local, never in a tracked file.

config APP_CAL_TZ
    string "Local time zone (POSIX TZ string)"
    default "GMT0IST,M3.5.0/1,M10.5.0"
    help
        The zone the week is drawn in. Ireland by default. Examples:
        `GMT0BST,M3.5.0/1,M10.5.0` (UK), `CET-1CEST,M3.5.0,M10.5.0/3` (central Europe),
        `EST5EDT,M3.2.0,M11.1.0` (US Eastern).

config APP_CAL_HIDE_PRIVATE
    bool "Leave out events marked private"
    default y
    help
        Drops events with CLASS:PRIVATE or CLASS:CONFIDENTIAL -- Google's "Private"
        visibility -- so a panel in a shared room does not show them.

config APP_CAL_HTTP_TIMEOUT_MS
    int "Per-calendar HTTPS timeout (ms)"
    default 20000

endmenu
```

## components/app_cycle/Kconfig
```kconfig
menu "app_cycle -- wake and sleep"

config APP_CYCLE_INTERVAL_MIN
    int "Minutes between wakes"
    default 30
    range 5 720
    help
        Wakes land on the wall-clock grid (:00 and :30 by default). Each wake costs a
        Wi-Fi association and a TLS fetch per calendar, a few seconds at ~100 mA; the
        panel refreshes only when the picture changed.

config APP_CYCLE_QUIET_START_H
    int "Quiet hours start (local hour)"
    default 23
    range 0 23

config APP_CYCLE_QUIET_END_H
    int "Quiet hours end (local hour)"
    default 6
    range 0 23
    help
        No wakes between the start and end hour, local time; the first wake after is on
        the end hour. Set start and end equal to wake around the clock.

config APP_CYCLE_AWAKE_WINDOW_S
    int "Seconds to stay awake for setup or after a long KEY press"
    default 900
    range 60 3600

config APP_CYCLE_OTA_EVERY_H
    int "Hours between update checks"
    default 24
    range 1 168

config APP_CYCLE_SLEEP_ON_USB
    bool "Deep sleep even when USB power is present"
    default y
    help
        Off, a board on USB power stays awake: it redraws on the same grid, keeps its
        web page up and stays reachable for flashing. On, it behaves the same on USB as
        on battery, which is what to test before trusting a battery.

endmenu
```

## components/app_epd/Kconfig
```kconfig
menu "app_epd -- the ePaper panel"

config APP_EPD_ENABLE
    bool "Drive the PhotoPainter's 7.3\" Spectra 6 panel"
    default y
    help
        800x480, six inks. Switch it off to build the firmware without a panel.

comment "Pins -- defaults are the Waveshare ESP32-S3-PhotoPainter"

config APP_EPD_SCLK_GPIO
    int "SCLK"
    default 10

config APP_EPD_MOSI_GPIO
    int "MOSI"
    default 11

config APP_EPD_CS_GPIO
    int "Chip select"
    default 9

config APP_EPD_DC_GPIO
    int "Data/command"
    default 8

config APP_EPD_RST_GPIO
    int "Reset"
    default 12

config APP_EPD_BUSY_GPIO
    int "Busy"
    default 13
    help
        Driven by the panel, HIGH when idle.

if APP_EPD_ENABLE

config APP_EPD_ROTATE_180
    bool "Rotate the picture 180 degrees"
    default y
    help
        The PhotoPainter's stand holds the panel upside down relative to the
        controller's scan order: without this, an unrotated colour bar shows black on
        the right. Turn it off for a board mounted the other way round.

config APP_EPD_SPI_HZ
    int "SPI clock (Hz)"
    default 20000000
    help
        Waveshare's driver runs this panel at 40 MHz on the same board. 20 MHz moves the
        192 000-byte frame in under 100 ms against a ~25 s refresh, so the margin costs
        nothing.

endif

endmenu
```
